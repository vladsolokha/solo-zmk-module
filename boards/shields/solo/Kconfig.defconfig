## boards/shields/solo/Kconfig.defconfig
```kconfig
CONFIG_ZMK_SLEEP=y
CONFIG_ZMK_PM_SOFT_OFF=y
CONFIG_ZMK_POINTING=y

if SHIELD_SOLO_LEFT

config ZMK_KEYBOARD_NAME
    default "Solo-keeeb"

config ZMK_SPLIT_ROLE_CENTRAL
    default y

config ZMK_STUDIO
    default y

endif

if SHIELD_SOLO_LEFT || SHIELD_SOLO_RIGHT

config ZMK_SPLIT
    default y

endif
```

## boards/shields/solo/Kconfig.shield
```kconfig
config SHIELD_SOLO_LEFT
    def_bool $(shields_list_contains,solo_left)

config SHIELD_SOLO_RIGHT
    def_bool $(shields_list_contains,solo_right)
```
