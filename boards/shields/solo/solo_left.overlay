#include "solo.dtsi"

&kscan0 {
    col-gpios
    = <&gpio0 28 GPIO_ACTIVE_HIGH>
    , <&gpio0 2 GPIO_ACTIVE_HIGH>
    , <&gpio0 4 GPIO_ACTIVE_HIGH>
    , <&gpio0 5 GPIO_ACTIVE_HIGH>
    , <&gpio1 11 GPIO_ACTIVE_HIGH>
    ;

    row-gpios
    = <&gpio1 15 (GPIO_ACTIVE_HIGH | GPIO_PULL_DOWN)>
    , <&gpio1 14 (GPIO_ACTIVE_HIGH | GPIO_PULL_DOWN)>
    , <&gpio1 13 (GPIO_ACTIVE_HIGH | GPIO_PULL_DOWN)>
    , <&gpio1 12 (GPIO_ACTIVE_HIGH | GPIO_PULL_DOWN)>
    ;
};
